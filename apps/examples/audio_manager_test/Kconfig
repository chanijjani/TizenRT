## apps/examples/audio_manager_test/Kconfig
```kconfig
#
# For a description of the syntax of this configuration file,
# see kconfig-language at https://www.kernel.org/doc/Documentation/kbuild/kconfig-language.txt
#

config EXAMPLES_AUDIO_MANAGER_TEST
	bool "AUDIO_MANAGER test example"
	depends on AUDIO
	default y
	---help---
		Enable the audio_manager example in tash

if EXAMPLES_AUDIO_MANAGER_TEST

config EXAMPLES_AUDIO_MANAGER_TEST_PROGNAME
	string "Program name"
	default "audio_manager_test"
	depends on BUILD_KERNEL
	---help---
		This is the name of the program that will be use when the NSH ELF
		program is installed.

endif

config USER_ENTRYPOINT
	string
	default "audio_manager_test_main" if ENTRY_AUDIO_MANAGER_TEST
```

## apps/examples/security_test/Kconfig
```kconfig
#
# For a description of the syntax of this configuration file,
# see kconfig-language at https://www.kernel.org/doc/Documentation/kbuild/kconfig-language.txt
#

config EXAMPLES_SECURITY_API_TEST
	bool "Security API Test program"
	default n
	depends on SECURITY_API && SECURITY_LINK && CONFIG_SE 
	select STRESS_TOOL
	---help---
		Enable Security API Test

config USER_ENTRYPOINT
	string
	default "security API test" if ENTRY_SECURITY_API_TEST
```

## apps/examples/testcase/ta_tc/database/utc/Kconfig
```kconfig
#
# For a description of the syntax of this configuration file,
# see kconfig-language at https://www.kernel.org/doc/Documentation/kbuild/kconfig-language.txt
#

config EXAMPLES_TESTCASE_DATABASE_UTC
	bool "Database UTC TestCase Example"
	select DATABASE
	default n
	---help---
		Enable the Database TestCase example
```
